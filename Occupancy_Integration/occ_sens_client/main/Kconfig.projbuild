## Occupancy_Integration/occ_sens_client/main/Kconfig.projbuild
```kconfig
menu "Example Configuration"

    choice
        prompt "Enterprise configuration to be used"
        default EXAMPLE_WPA_WPA2_ENTERPRISE
        config EXAMPLE_WPA_WPA2_ENTERPRISE
            bool "WPA_WPA2_ENT"
        config EXAMPLE_WPA3_ENTERPRISE
            bool "WPA3_ENT"
        config EXAMPLE_WPA3_192BIT_ENTERPRISE
            bool "WPA3_192BIT_ENT"
            depends on IDF_TARGET_ESP32C3 || IDF_TARGET_ESP32S3
            select ESP_WIFI_GCMP_SUPPORT
            select ESP_WIFI_GMAC_SUPPORT
            select WPA_SUITE_B_192
    endchoice

    config EXAMPLE_WIFI_SSID
        string "WiFi SSID"
        default "wpa2_test"
        help
            SSID (network name) for the example to connect to.

    if EXAMPLE_WPA_WPA2_ENTERPRISE
        config EXAMPLE_VALIDATE_SERVER_CERT
            bool "Validate server"
            default y
            help
                Validate the servers' certificate using CA cert.
    endif

    if !EXAMPLE_WPA_WPA2_ENTERPRISE
        config EXAMPLE_VALIDATE_SERVER_CERT
            default y
    endif

    choice
        prompt "EAP method for the example to use"
        default EXAMPLE_EAP_METHOD_PEAP
        config EXAMPLE_EAP_METHOD_TLS
            bool "TLS"
        config EXAMPLE_EAP_METHOD_PEAP
            bool "PEAP"
        config EXAMPLE_EAP_METHOD_TTLS
            bool "TTLS"
    endchoice

    config EXAMPLE_EAP_METHOD
        int
        default 0 if EXAMPLE_EAP_METHOD_TLS
        default 1 if EXAMPLE_EAP_METHOD_PEAP
        default 2 if EXAMPLE_EAP_METHOD_TTLS

    choice
        prompt "Phase2 method for TTLS"
        depends on EXAMPLE_EAP_METHOD_TTLS
        default EXAMPLE_EAP_METHOD_TTLS_PHASE2_MSCHAPV2
        config EXAMPLE_EAP_METHOD_TTLS_PHASE2_MSCHAPV2
            bool "MSCHAPV2"
        config EXAMPLE_EAP_METHOD_TTLS_PHASE2_MSCHAP
            bool "MSCHAP"
        config EXAMPLE_EAP_METHOD_TTLS_PHASE2_PAP
            bool "PAP"
        config EXAMPLE_EAP_METHOD_TTLS_PHASE2_CHAP
            bool "CHAP"
    endchoice

    config EXAMPLE_EAP_METHOD_TTLS_PHASE_2
        int
        default 1 if EXAMPLE_EAP_METHOD_TTLS_PHASE2_MSCHAPV2
        default 2 if EXAMPLE_EAP_METHOD_TTLS_PHASE2_MSCHAP
        default 3 if EXAMPLE_EAP_METHOD_TTLS_PHASE2_PAP
        default 4 if EXAMPLE_EAP_METHOD_TTLS_PHASE2_CHAP

    config EXAMPLE_EAP_ID
        string "EAP ID"
        default "example@espressif.com"
        help
            Identity in phase 1 of EAP procedure.

    config EXAMPLE_EAP_USERNAME
        string "EAP USERNAME"
        depends on EXAMPLE_EAP_METHOD_PEAP || EXAMPLE_EAP_METHOD_TTLS
        default "espressif"
        help
            Username for EAP method (PEAP and TTLS).

    config EXAMPLE_EAP_PASSWORD
        string "EAP PASSWORD"
        depends on EXAMPLE_EAP_METHOD_PEAP || EXAMPLE_EAP_METHOD_TTLS
        default "test11"
        help
            Password for EAP method (PEAP and TTLS).
    
    config EXAMPLE_UART_PORT_NUM
            int "UART port number"
            range 0 2 if IDF_TARGET_ESP32 || IDF_TARGET_ESP32S3
            default 2 if IDF_TARGET_ESP32 || IDF_TARGET_ESP32S3
            range 0 1 if IDF_TARGET_ESP32S2 || IDF_TARGET_ESP32C3
            default 1 if IDF_TARGET_ESP32S2 || IDF_TARGET_ESP32C3
            help
                UART communication port number for the example.
                See UART documentation for available port numbers.
    
        config EXAMPLE_UART_BAUD_RATE
            int "UART communication speed"
            range 1200 115200
            default 115200
            help
                UART communication speed for Modbus example.
    
        config EXAMPLE_UART_RXD
            int "UART RXD pin number"
            range 0 34 if IDF_TARGET_ESP32
            range 0 46 if IDF_TARGET_ESP32S2 || IDF_TARGET_ESP32S3
            range 0 19 if IDF_TARGET_ESP32C3
            range 0 47 if IDF_TARGET_ESP32S3
            default 5
            help
                GPIO number for UART RX pin. See UART documentation for more information
                about available pin numbers for UART.
    
        config EXAMPLE_UART_TXD
            int "UART TXD pin number"
            range 0 34 if IDF_TARGET_ESP32
            range 0 46 if IDF_TARGET_ESP32S2 || IDF_TARGET_ESP32S3
            range 0 19 if IDF_TARGET_ESP32C3
            range 0 47 if IDF_TARGET_ESP32S3
            default 4
            help
                GPIO number for UART TX pin. See UART documentation for more information
                about available pin numbers for UART.
    
        config EXAMPLE_TASK_STACK_SIZE
            int "UART echo example task stack size"
            range 1024 16384
            default 2048
            help
                Defines stack size for UART echo example. Insufficient stack size can cause crash.
endmenu
```
